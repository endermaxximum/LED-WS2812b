#include <ESP8266WiFi.h>
#include <JsonListener.h>
#include <WundergroundConditions.h>
#include "MD_MAX72xx.h"
#include <time.h>

#define WIFI_SSID     "ssid"
#define WIFI_PASSWORD "passw0rd"
char ntp_server1[20] = "ntp.ku.ac.th";
char ntp_server2[20] = "fw.eng.ku.ac.th";
char ntp_server3[20] = "time.uni.net.th";
int timezone = 7;
int dst = 0;
unsigned long curTime, changeMode;
int tmy, tmm, tmd, tmw, dots, mode;
String tms = "";

// Wunderground Settings : https://www.wunderground.com/weather/api/
const int UPDATE_INTERVAL_SECS = 10 * 60; // Update every 10 minutes
bool IS_METRIC = true;
const String WUNDERGRROUND_API_KEY = "you wunderground api key";
const String WUNDERGRROUND_LANGUAGE = "EN";
const String WUNDERGROUND_COUNTRY = "Thailand";
const String WUNDERGROUND_CITY = "Samui";  // you city
long lastDownloadUpdate = millis();
WGConditions conditions;

char* weekdayNames[] = {"อาทิตย์", "จันทร์", "อังคาร", "พุธ", "พฤหัสบดี", "ศุกร์", "เสาร์"};
char* monthNames[] = {"มกราคม", "กุมภาพันธ์", "มีนาคม", "เมษายน", "พฤษภาคม", "มิถุนายน",
                      "กรกฎาคม", "สิงหาคม", "กันยายน", "ตุลาคม", "พฤศจิกายน", "ธันวาคม"};

int g_pcman_char = 0;
int g_pcman_n = 0;

#define MAX_DEVICES 16  //32
#define CLK_PIN   D5
#define CS_PIN    D8
#define DATA_PIN  D7

MD_MAX72XX mx = MD_MAX72XX(CS_PIN, MAX_DEVICES);

int TD_max_row = 16;
int TD_max_col = (MAX_DEVICES / 8) * 32;
int TD_max_char_row1 = 16;
int TD_max_char_row2 = 12;
int TD_max_char_col = 16;
int TD_normal_row = 1;
int TD_start_not_thai_char = 33;
int TD_start_thai_char = 161;
int TD_gap_pixel = 2;
int TD_led_delay = 20;

// thai over
const int char_char_x1 = 13;
int char_x1[char_char_x1] = { 209, 212, 213, 214, 215, 231, 232, 233, 234, 235, 236, 237, 238 };

// thai under
const int char_char_x2 = 2;
int char_x2[char_char_x2] = { 216, 217 };

unsigned int char_data1[94][16] = {
  {61440, 61440, 61440, 61440, 61440, 61440, 61440, 61440, 61440, 61440, 0, 0, 24576, 61440, 61440, 24576}, //  33  !
  {55296, 55296, 18432, 18432, 0, 0, 0, 0, 0, 0, 0, 0, 0, 0, 0, 0}, //  34 "
  {0, 0, 0, 0, 2176, 2176, 32736, 4352, 4352, 4352, 65472, 8704, 8704, 0, 0, 0}, //  35  #
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  {0, 16128, 32640, 57792, 49344, 49344, 57792, 32704, 16320, 192, 192, 192, 448, 16256, 16128, 0},  //  57  9
  //{0, 0, 0, 24576, 61440, 61440, 24576, 0, 0, 24576, 61440, 61440, 24576, 0, 0, 0}, //  58  :
  {0, 0, 12288, 30720, 64512, 30720, 12288, 0, 0, 12288, 30720, 64512, 30720, 12288, 0, 0}, //  :
  {0, 0, 0, 24576, 61440, 61440, 24576, 0, 28672, 28672, 61440, 57344, 49152, 0, 0, 0}, //  59  ;
  {0, 0, 0, 3072, 6144, 12288, 24576, 49152, 49152, 24576, 12288, 6144, 3072, 0, 0, 0}, //  60  <
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  {0, 0, 0, 49152, 8192, 8192, 8192, 14336, 14336, 8192, 8192, 8192, 49152, 0, 0, 0}, //  125  }
};

unsigned int char_data2[78][12] = {
  {0, 0, 0, 64512, 52224, 19456, 52224, 52224, 52224, 52224, 0, 0}, // 161 ก
  {0, 0, 0, 60416, 60416, 27648, 27648, 27648, 27648, 30720, 0, 0}, // 162 ข
  {0, 0, 0, 44032, 60416, 27648, 27648, 27648, 27648, 30720, 0, 0}, // 163 ฃ
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  {8160, 16368, 25080, 65532, 2044, 124, 124, 2044, 65532, 32761, 16382, 8160}, //
  {},
  {},
  {},
  {0, 0, 0, 49152, 49152, 49152, 49152, 49152, 49152, 49152, 0, 0}, // 224 เ
  {0, 0, 0, 27648, 27648, 27648, 27648, 27648, 27648, 27648, 0, 0}, // 225 แ
  {28672, 57344, 24576, 24576, 24576, 24576, 24576, 24576, 24576, 24576, 0, 0}, // 226 โ
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  {3072, 3072, 0, 0, 0, 0, 0, 0, 0, 0, 0, 0}, // 238 ๎
};

void TD_setPoint(uint16_t r, uint16_t c, bool state) {
  uint16_t nr = 0;
  uint16_t nc = 0;
  uint16_t n = 0;
  uint16_t c0 = 0;

  if (r <= 0 || r > TD_max_row) return;
  if (c <= 0 || c > TD_max_col) return;

  n = 0;
  if (r > 8) {
    r = r - 8;
    n = 32;
  }

  c0 = c;
  nc = 1;
  while (c0 > 32) {
    c0 = c0 - 32;
    nc = nc + 1;
  }

  nc = (TD_max_col * 2) - (32 * nc) - c + n;
  nr = r - 1;

  mx.MysetPoint(nr, nc, state);
}

char * TD_IntToBin(unsigned int p_ui) {
  static char ret[17];        // need to change if expand font width

  for (int i = 0; i < TD_max_char_col; i++) ret[TD_max_char_col - 1 - i] = '0' + ((p_ui & (1 << i)) > 0);
  ret[TD_max_char_col] = '\0';

  return ret;
}

void TD_SerialShowBinChar2(int p_idx) {
  String c;

  Serial.println(p_idx);
  for (int i = 0; i < TD_max_char_row2; i++) {
    c = TD_IntToBin(char_data2[p_idx][i]);
    c.replace("1", "X");
    c.replace("0", " ");
    Serial.println(c);
  }
  Serial.println("");
}

int TD_IsX1(int idx) {
  int ret = 0;

  for (int i = 0; i < char_char_x1; i++) {
    if (char_x1[i] == idx) {
      ret = 1;
      break;
    }
  }

  return ret;
}

int TD_IsX2(int idx) {
  int ret = 0;

  for (int i = 0; i < char_char_x2; i++) {
    if (char_x2[i] == idx) {
      ret = 1;
      break;
    }
  }

  return ret;
}

void TD_WriteChar(int p_r, int p_c, int p_idx) {
  char * c;

  if (p_idx == 219) {
    if (g_pcman_n == 0) {
      if (g_pcman_char == 220) {
        g_pcman_char = 219;
      } else {
        g_pcman_char = 220;
      }
    }
    p_idx = g_pcman_char;
    g_pcman_n = g_pcman_n + 1;
    if (g_pcman_n == 8) g_pcman_n = 0;
  }

  // not thai
  if (p_idx < TD_start_thai_char) {
    p_idx = p_idx - TD_start_not_thai_char;
    //TD_SerialShowBinChar2(p_idx);

    for (int i = 0; i < TD_max_char_row1; i++) {
      c =  TD_IntToBin(char_data1[p_idx][i]);
      for (int j = 0; j < TD_max_char_col; j++)
        if (c[j] == '1') {
          TD_setPoint(p_r + i, p_c + j, true);
        }
    }
    // thai
  } else {
    p_idx = p_idx - TD_start_thai_char;
    //TD_SerialShowBinChar2(p_idx);

    for (int i = 0; i < TD_max_char_row2; i++) {
      c =  TD_IntToBin(char_data2[p_idx][i]);
      for (int j = 0; j < TD_max_char_col; j++)
        if (c[j] == '1') {
          TD_setPoint(p_r + i, p_c + j, true);
        }
    }
  }
}

int TD_CharWidth(int p_idx) {
  char * c;
  int w = 0;

  if (p_idx < TD_start_thai_char) {
    p_idx = p_idx - TD_start_not_thai_char;

    for (int i = 0; i < TD_max_char_row1; i++) {
      c =  TD_IntToBin(char_data1[p_idx][i]);
      for (int j = 0; j < TD_max_char_col; j++)
        if (c[j] == '1') {
          if (j >= w) w = j;
        }
    }

    // thai
  } else {
    p_idx = p_idx - TD_start_thai_char;

    for (int i = 0; i < TD_max_char_row2; i++) {
      c =  TD_IntToBin(char_data2[p_idx][i]);
      for (int j = 0; j < TD_max_char_col; j++)
        if (c[j] == '1') {
          if (j >= w) w = j;
        }
    }
  }

  return w + 1;
}

int TD_Char2Width(int p_idx) {
  char * c;
  int w = 0;

  for (int i = 0; i < TD_max_char_row2; i++) {
    c =  TD_IntToBin(char_data2[p_idx][i]);
    for (int j = 0; j < TD_max_char_col; j++)
      if (c[j] == '1') {
        if (j >= w) w = j;
      }
  }

  return w + 1;
}

void TD_LEDWriteText(int p_r, int p_c, String p_text) {
  char c1;
  char c2;
  int w = 0;
  int idx = 0;
  int normal;
  String myText;

  myText = p_text;
  mx.clear();
  for (int i = 0; i < myText.length(); i++) {
    c1 = myText[i];
    // E0 224 Thai
    if ((int)c1 == 224) {
      c1 = myText[i + 1];
      c2 = myText[i + 2];
      // B8,81(129)  ก - ฮ
      if ((int)c1 == 184 && ((int)c2 + 32) >= 161 && ((int)c2 + 32) <= 207) {
        // ก 81 = 129 --> +32 --> 161
        idx = (int)c2 + 32;
      }
      // B8,B0(176)  สระ
      if ((int)c1 == 184 && ((int)c2 + 32) >= 208 && ((int)c2 + 32) <= 218) {
        // ะ B0 = 176 --> +32 --> 208
        idx = (int)c2 + 32;
      }
      // B9,80(128)  สระ
      if ((int)c1 == 185 && ((int)c2 + 96) >= 224 && ((int)c2 + 96) <= 231) {
        // เ 80 = 176 --> +96 --> 224
        idx = (int)c2 + 96;
      }
      // B9,B0(136)  วรรณยุก
      if ((int)c1 == 185 && ((int)c2 + 96) >= 232 && ((int)c2 + 96) <= 238) {
        // ่ 88 = 136 --> +96 --> 208
        idx = (int)c2 + 96;
      }
      i = i + 2;
    } else {
      idx = (int)c1;
    }

    normal = 1;
    // thai over
    if (TD_IsX1(idx) == 1) {
      w = TD_CharWidth(idx);
      TD_WriteChar(p_r - 2, p_c - (w + TD_gap_pixel), idx);
      normal = 0;
    }
    // thai under
    if (TD_IsX2(idx) == 1) {
      w = TD_CharWidth(idx);
      TD_WriteChar(p_r + 10, p_c - (w + TD_gap_pixel), idx);
      normal = 0;
    }
    if (normal == 1) {
      switch (idx) {
        case 32:  // space
          p_c = p_c + 8;
          break;
        case 211: // ำ
          w = TD_CharWidth(idx);
          TD_WriteChar(p_r, p_c - (3 + TD_gap_pixel), idx);
          p_c = p_c - 3 + w + TD_gap_pixel;
          break;
        default:
          TD_WriteChar(p_r, p_c, idx);
          w = TD_CharWidth(idx);
          p_c = p_c + w + TD_gap_pixel;
          break;
      }
    }
  }
  mx.MyflushBufferAll();
  delay(TD_led_delay);

}

int TD_LEDTextPixel(String p_text) {
  char c1;
  char c2;
  int w = 0;
  int idx = 0;
  int normal;
  String myText;
  int p_c;

  p_c = 0;
  myText = p_text;
  for (int i = 0; i < myText.length(); i++) {
    c1 = myText[i];
    // E0 224 Thai
    if ((int)c1 == 224) {
      c1 = myText[i + 1];
      c2 = myText[i + 2];
      // B8,81(129)  ก - ฮ
      if ((int)c1 == 184 && ((int)c2 + 32) >= 161 && ((int)c2 + 32) <= 207) {
        // ก 81 = 129 --> +32 --> 161
        idx = (int)c2 + 32;
      }
      // B8,B0(176)  สระ
      if ((int)c1 == 184 && ((int)c2 + 32) >= 208 && ((int)c2 + 32) <= 218) {
        // ะ B0 = 176 --> +32 --> 208
        idx = (int)c2 + 32;
      }
      // B9,80(128)  สระ
      if ((int)c1 == 185 && ((int)c2 + 96) >= 224 && ((int)c2 + 96) <= 231) {
        // เ 80 = 176 --> +96 --> 224
        idx = (int)c2 + 96;
      }
      // B9,B0(136)  วรรณยุก
      if ((int)c1 == 185 && ((int)c2 + 96) >= 232 && ((int)c2 + 96) <= 238) {
        // ่ 88 = 136 --> +96 --> 208
        idx = (int)c2 + 96;
      }
      i = i + 2;
    } else {
      idx = (int)c1;
    }

    normal = 1;
    // thai over
    if (TD_IsX1(idx) == 1) {
    }
    // thai under
    if (TD_IsX2(idx) == 1) {
      w = TD_CharWidth(idx);
      normal = 0;
    }
    if (normal == 1) {
      switch (idx) {
        case 32:  // space
          p_c = p_c + 8;
          break;
        case 211: // ำ
          w = TD_CharWidth(idx);
          p_c = p_c - 3 + w + TD_gap_pixel;
          break;
        default:
          w = TD_CharWidth(idx);
          p_c = p_c + w + TD_gap_pixel;
          break;
      }
    }
  }

  return p_c;

}

void TD_LEDText(String p_text) {
  TD_LEDWriteText(TD_normal_row, 1, p_text);
}

void TD_LEDScrollText(String p_text) {
  int c;
  int n;

  n = TD_LEDTextPixel(p_text);
  for (int i = TD_max_col; i >= n * -1; i--) {
    TD_LEDWriteText(TD_normal_row, i, p_text);
  }
}

//////////////////////////////////////////*******************************************************************************************/////////////////////////////////////////////////////

void setup() {
  Serial.begin(115200);
  mx.begin();
  WiFi.begin(WIFI_SSID, WIFI_PASSWORD);
  Serial.print("connecting");
  while (WiFi.status() != WL_CONNECTED) {
    Serial.print(".");
    delay(500);
  }
  Serial.println();
  Serial.print("connected: ");
  Serial.println(WiFi.localIP());

  configTime(timezone * 3600, dst, ntp_server1, ntp_server2, ntp_server3);
  Serial.println("Waiting for time");
  while (!time(nullptr)) {
    Serial.print(".");
    delay(500);
  }
  Serial.println();
  updateData();
}

void loop() {
  curTime = millis();
  dots = (curTime % 1000) < 500;
  time_t now = time(nullptr);
  struct tm* newtime = localtime(&now);
  tmy = (newtime->tm_year + 2443);
  tmm = (newtime->tm_mon);
  tmw = (newtime->tm_wday);
  tmd = (newtime->tm_mday);
  tms = "";
  if ((newtime->tm_hour) > 9 || (newtime->tm_hour) < 20 ) tms += " ";
  if ((newtime->tm_hour) < 10) tms += "0";
  tms += (newtime->tm_hour);
  if (dots) tms += ":"; else tms += " ";
  if ((newtime->tm_min) < 10) tms += "0";
  tms += (newtime->tm_min);

  drawTime();
  
  if (millis() - lastDownloadUpdate > 1000 * UPDATE_INTERVAL_SECS) {
    updateData();
    lastDownloadUpdate = millis();
  }
  
  if (curTime - changeMode >= 30000) drawWeather();
  
}

void drawTime() {
  TD_LEDText(tms);
}

void updateData() {
  TD_LEDScrollText((String)"อัพเดท");
  WundergroundConditions *conditionsClient = new WundergroundConditions(IS_METRIC);
  conditionsClient->updateConditions(&conditions, WUNDERGRROUND_API_KEY, WUNDERGRROUND_LANGUAGE, WUNDERGROUND_COUNTRY, WUNDERGROUND_CITY);
  delete conditionsClient;
  conditionsClient = nullptr;
}

void drawWeather() {
  changeMode = millis();
  String temp = conditions.currentTemp;
  
  String condi = "";
  if (conditions.weatherText == "Chance of Flurries") condi += "อาจจะมีละอองฝน";
  if (conditions.weatherText == "Chance of Rain") condi += "อาจจะมีฝนตก";
  if (conditions.weatherText == "Chance of Sleet") condi += "อาจจะมีฝนหิมะ";
  if (conditions.weatherText == "Chance of Snow") condi += "อาจจะมีหิมะตก";
  if (conditions.weatherText == "Chance of Storms") condi += "อาจจะมีพายุ";
  if (conditions.weatherText == "Clear") condi += "บรรยากาศแจ่มใส";
  if (conditions.weatherText == "Cloudy") condi += "มีเมฆมาก";
  if (conditions.weatherText == "Flurries") condi += "มีฝนตกปรอยๆ";
  if (conditions.weatherText == "Fog") condi += "มีหมอกบาง";
  if (conditions.weatherText == "Hazy") condi += "มีหมอกหนา";
  if (conditions.weatherText == "Mostly Cloudy") condi += "มีเมฆเป็นส่วนใหญ่";
  if (conditions.weatherText == "Mostly Sunny") condi += "มีแดดออกเป็นส่วนใหญ่";
  if (conditions.weatherText == "Partly Cloudy") condi += "มีเมฆเป็นบางส่วน";
  if (conditions.weatherText == "Partly Sunny") condi += "มีแดดออกเป็นบางส่วน";
  if (conditions.weatherText == "Sleet") condi += "มีฝนหิมะ";
  if (conditions.weatherText == "Rain") condi += "มีฝนตก";
  if (conditions.weatherText == "Snow") condi += "มีหิมะตก";
  if (conditions.weatherText == "Sunny") condi += "มีแดดจ้า";
  if (conditions.weatherText == "Storms") condi += "มีพายุ";

  String tmwtemp = tmw[weekdayNames];
  String tmmtemp = tmm[monthNames];

  TD_LEDScrollText(tmwtemp + " " + tmd + " " + tmmtemp + " " + tmy + " อุณหภูมิ " + temp + "C " + condi);

}

